## zephyr/Kconfig
```kconfig
menu "Qoraal"

config QORAAL
    bool "Enable Qoraal framework"
    default n
    depends on MULTITHREADING
    depends on ARCH_HAS_THREAD_LOCAL_STORAGE
    depends on NUM_PREEMPT_PRIORITIES >= 14
    depends on !SMP
    select EVENTS
    select THREAD_LOCAL_STORAGE
    select THREAD_NAME
    help
      Enable the Qoraal framework Zephyr port. The current port requires
      thread-local storage and at least 14 preemptive priority levels. SMP is
      intentionally unsupported until Qoraal's higher-level global data
      structures are made SMP-safe.

if QORAAL

config QORAAL_SVC_EVENTS_SYSWORKQ
    bool "Dispatch service events on the system workqueue"
    default n
    help
      Use Zephyr's system workqueue instead of a dedicated svc-events thread.
      Event callbacks share the system workqueue's priority and stack, and
      must finish promptly. Use svc_tasks for lengthy or blocking work.

config QORAAL_QFS
    bool "Enable Qoraal file system"
    default y

config QORAAL_QSHELL_PROMPT
    string "Qoraal shell prompt"
    default "[Qoraal] #> "

config QORAAL_QSHELL_HISTORY_DEPTH
    int "Qoraal shell history depth"
    default 8
    range 0 255
    help
      Number of commands the shell keeps for recall with the up and down
      arrows. Each one costs QORAAL_QSHELL_HISTORY_LEN + 1 bytes of RAM.
      0 leaves the history out.

config QORAAL_QSHELL_HISTORY_LEN
    int "Longest command kept in the Qoraal shell history"
    default 128
    range 1 255
    help
      Longest command, in characters, the shell history stores. A longer
      command is not stored at all rather than stored cut off. The shell
      line itself stays 255 characters.

endif # QORAAL

endmenu
```
